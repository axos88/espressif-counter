## CMakeLists.txt
```
# Copyright (c) 2026 LVGL
# SPDX-License-Identifier: Apache-2.0

cmake_minimum_required(VERSION 3.20.0)

# Per-board defaults: boards/<board>.cmake sets variables (e.g. SHIELD) not already provided.
# Normalize the raw BOARD spec by stripping @<revision> and replacing / with _ to match the
# naming convention used for boards/<board>.conf and boards/<board>.overlay.
string(REGEX REPLACE "@[^/]*" "" _board_norm "${BOARD}")
string(REPLACE "/" "_" _board_norm "${_board_norm}")
include("${CMAKE_CURRENT_SOURCE_DIR}/boards/${_board_norm}.cmake" OPTIONAL)
unset(_board_norm)

# Board overlay loading order:
#   1. boards/pre-shield-overlays/<board>.overlay — via BOARD_EXTENSION_DIRS, applied before shield overlays
#   2. shield overlay                              — applied by west (--shield flag)
#   3. boards/<board>.overlay                      — auto-discovered by Zephyr, applied after shield overlays
list(APPEND BOARD_EXTENSION_DIRS ${CMAKE_CURRENT_SOURCE_DIR}/boards/pre-shield-overlays)

find_package(Zephyr REQUIRED HINTS $ENV{ZEPHYR_BASE})
project(lvgl_application)

# The Editor-generated UI includes LVGL as `#include "lvgl.h"`.
zephyr_compile_definitions(LV_LVGL_H_INCLUDE_SIMPLE)

# Application sources.
target_sources(app PRIVATE src/main.c)

# Build the UI exported from the LVGL Editor. ui/CMakeLists.txt produces a
# `lib-ui` library; link it to the app and give it LVGL's include paths.
add_subdirectory(ui)
target_link_libraries(lib-ui PUBLIC zephyr_interface)
target_link_libraries(app PRIVATE lib-ui)
```

## prj.conf
```kconfig
CONFIG_MAIN_STACK_SIZE=16384
CONFIG_LOG=y
CONFIG_SHELL=y

CONFIG_LVGL=y
CONFIG_LV_Z_MEM_POOL_SIZE=49152
CONFIG_LV_Z_SHELL=y
CONFIG_LV_USE_MONKEY=y

CONFIG_DISPLAY=y
CONFIG_INPUT=y
CONFIG_LV_Z_POINTER_INPUT_MSGQ_COUNT=20

CONFIG_LV_USE_SYSMON=y
CONFIG_LV_USE_PERF_MONITOR=y

CONFIG_LV_FONT_MONTSERRAT_12=y
CONFIG_LV_FONT_MONTSERRAT_14=y
CONFIG_LV_FONT_MONTSERRAT_16=y
CONFIG_LV_FONT_MONTSERRAT_18=y
CONFIG_LV_FONT_MONTSERRAT_24=y
CONFIG_LV_USE_DEMO_WIDGETS=y

# Benchmark Demo
CONFIG_LV_USE_FONT_COMPRESSED=y

CONFIG_LV_USE_OBJ_NAME=y
CONFIG_LV_USE_TRANSLATION=y
```

## src/main.c
```c
/*
 * Copyright (c) 2026 LVGL
 *
 * SPDX-License-Identifier: Apache-2.0
 */

#include <zephyr/kernel.h>
#include <zephyr/drivers/display.h>
#include <lvgl.h>
#include <lvgl_mem.h>
#include <lvgl_zephyr.h>
#include <stdio.h>
#include "../ui/ui.h"

#define LOG_LEVEL CONFIG_LOG_DEFAULT_LEVEL
#include <zephyr/logging/log.h>
LOG_MODULE_REGISTER(app);

int main(void)
{
	const struct device *display_dev;
	int ret;

	display_dev = DEVICE_DT_GET(DT_CHOSEN(zephyr_display));
	if (!device_is_ready(display_dev)) {
		LOG_ERR("Display device not ready, aborting");
		return 0;
	}

	/* LVGL is initialized by the Zephyr LVGL module before main() runs.
	 * The lock protects LVGL state from concurrent access, e.g. by the
	 * shell or a rendering workqueue.
	 */
	lvgl_lock();

    ui_init("A:");
//  Replace the label creation below with a screen load function, like:    
//	lv_screen_load(my_screen_create());
    lv_obj_t * label = lv_label_create(lv_screen_active());
    lv_obj_center(label);
    lv_obj_set_width(label, lv_pct(80));
    lv_obj_set_style_text_align(label, LV_TEXT_ALIGN_CENTER, 0);
    lv_label_set_text(label, "Call lv_screen_load(my_screen_create()) in main.c to load a screen of a UI");


#ifndef CONFIG_LV_Z_RUN_LVGL_ON_WORKQUEUE
	lv_timer_handler();
#endif
	lvgl_unlock();

	ret = display_blanking_off(display_dev);
	if (ret < 0 && ret != -ENOSYS) {
		LOG_ERR("Failed to turn blanking off (error %d)", ret);
		return 0;
	}

#ifdef CONFIG_LV_Z_MEM_POOL_SYS_HEAP
	lvgl_print_heap_info(false);
#else
	printf("lvgl in malloc mode\n");
#endif

	while (1) {
#ifdef CONFIG_LV_Z_RUN_LVGL_ON_WORKQUEUE
		/* LVGL is driven by a dedicated workqueue */
		k_msleep(10);
#else
		uint32_t sleep_ms;

		lvgl_lock();
		sleep_ms = lv_timer_handler();
		lvgl_unlock();

		k_msleep(MIN(sleep_ms, 10));
#endif
	}

	return 0;
}
```
